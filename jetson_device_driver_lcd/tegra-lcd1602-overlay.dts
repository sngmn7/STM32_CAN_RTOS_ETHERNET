/dts-v1/;
/plugin/;

/*
 * tegra-lcd1602-overlay.dts
 *
 * Jetson Orin Nano Super 40핀 헤더 I2C(핀 3=SDA, 5=SCL, 보통 i2c-7)에
 * 1602A + PCF8574 백팩을 등록하는 오버레이.
 *
 *  ★ 주의 ★
 *  target-path 는 보드/BSP 버전마다 다르다. 반드시 아래로 먼저 확인할 것:
 *
 *      ls -l /sys/bus/i2c/devices/i2c-7/of_node
 *
 *  출력된 경로(예: /proc/device-tree/bus@0/i2c@c240000)에서
 *  "/proc/device-tree" 를 뗀 나머지를 target-path 에 그대로 넣는다.
 *
 *  I2C 주소도 확인 필요:
 *      sudo i2cdetect -y -r 7
 *  보통 0x27 (PCF8574) 또는 0x3F (PCF8574A) 로 잡힌다.
 */

/ {
	overlay-name = "LCD1602 I2C Character Display";
	compatible = "nvidia,p3768-0000+p3767-0005", "nvidia,tegra234";

	fragment@0 {
		target-path = "/bus@0/i2c@c240000";

		__overlay__ {
			#address-cells = <1>;
			#size-cells = <0>;
			status = "okay";

			lcd1602@27 {
				compatible = "seungmin,lcd1602";
				reg = <0x27>;
				status = "okay";
			};
		};
	};
};
